
CREATE_PASSWORD:

	MOV COUNT9, #04H
	MOV DPTR,#PASSWORD
	MOV R0,#50H
	UP2:
	CLR A
	MOVC A, @A+DPTR
	MOV @R0, A
	INC R0
	INC DPTR
	DJNZ COUNT9, UP2
	MOV DPTR, #7001H
	MOV R0, #50H
	MOV COUNT9, #04H
	LCALL WRITE_DATA
	RET

READ_PASSWORD:
	MOV R1, #54H
	MOV DPTR, #7001H
	MOV COUNT9, #4H
	LCALL READ_DATA
	MOV COUNT9, #04H
	MOV R0, #54H		;STARTING TO DISPLAY THE PASSWORD ON THE LCD
	UP3:
	MOV A,@R0
	LCALL DISP
	INC R0
	DJNZ COUNT9, UP3
	RET





VER_PASSWORD:
	MOV A, #01H
	LCALL CMD
	MOV DPTR, #AUTH_MSG
	LCALL DISPCH2
	LCALL SECOND
	MOV R0, #06H
	MOV A, #14H
	LOOP5:
	LCALL CMD
	DJNZ R0, LOOP5
	MOV A, #0EH
	LCALL CMD
	LCALL READ_PASSWORD
	MOV R0, #54H
	MOV FLAG, #00H
	MOV R1, #4H
	LOOP4:
	MOV B, @R0
	LCALL KEYPD
	CJNE A, #'*', N103
	SJMP VER_PASSWORD
	N103:
	CJNE A, B, SET_FLAG
	N102:
	MOV A, #'*'
	LCALL DISP
	INC R0
	DJNZ R1,LOOP4
	MOV A, FLAG
	MOV B, #00H
	CJNE A, B, AUTH_FAIL
	RET
	AUTH_FAIL:
		MOV A, #01H
		LCALL CMD
		MOV DPTR, #AUTH_FAIL_MSG
		LCALL DISP_MSG
		SJMP VER_PASSWORD
	SET_FLAG:
		MOV FLAG, #0FFH
		SJMP N102		

